AUTOSAR XML (schema 00052)
package /DataTypes/SwAddrMethods
  sw addr method CODE: section-type=CODE
  sw addr method CONST: section-type=CONST
  sw addr method VAR: section-initialization-policy=INIT, section-type=VAR

AUTOSAR XML (schema 00052)
package /Components
  application sw component type untitled1
    behavior untitled1_IB: handle-termination-and-restart=NO-SUPPORT
      timing event Event_untitled1_Step: start-on-event=untitled1_Step, period=0.2
      runnable untitled1_Init
      runnable untitled1_Step

AUTOSAR XML (schema 00052)
package /Components/SwcImplementations
  swc implementation untitled1_Impl: programming-language=C, sw-version=1.2.1, used-code-generator=Embedded Coder 25.1 (R2025a) 21-Nov-2024, vendor-id=0, behavior=untitled1_IB
    code-descriptors:
      code Code
        artifact-descriptors:
          short-label=untitled1_c, category=SWSRC
          short-label=untitled1_data_c, category=SWSRC
          short-label=untitled1_h, category=SWHDR
          short-label=untitled1_private_h, category=SWHDR
          short-label=untitled1_types_h, category=SWHDR
    resource consumption RsrcCons_untitled1

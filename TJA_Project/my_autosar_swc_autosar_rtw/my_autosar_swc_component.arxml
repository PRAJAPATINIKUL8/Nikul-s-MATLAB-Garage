AUTOSAR XML (schema 00052)
package /Components
  application sw component type my_autosar_swc
    behavior my_autosar_swc_IB: handle-termination-and-restart=NO-SUPPORT
      timing event Event_my_autosar_swc_Step: start-on-event=my_autosar_swc_Step, period=0.2
      runnable my_autosar_swc_Init
      runnable my_autosar_swc_Step

AUTOSAR XML (schema 00052)
package /Components/SwcImplementations
  swc implementation my_autosar_swc_Impl: programming-language=C, sw-version=1.1.1, used-code-generator=Embedded Coder 25.1 (R2025a) 21-Nov-2024, vendor-id=0, behavior=my_autosar_swc_IB
    code-descriptors:
      code Code
        artifact-descriptors:
          short-label=my_autosar_swc_c, category=SWSRC
          short-label=my_autosar_swc_data_c, category=SWSRC
          short-label=my_autosar_swc_h, category=SWHDR
          short-label=my_autosar_swc_private_h, category=SWHDR
          short-label=my_autosar_swc_types_h, category=SWHDR
    resource consumption RsrcCons_my_autosar_swc
